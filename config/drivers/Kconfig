## config/drivers/Kconfig
```kconfig
# Copyright (c) 2024 The ZMK Contributors
# SPDX-License-Identifier: Apache-2.0

menu "ZMK Sensor Drivers"

rsource "sensor/*/Kconfig"

endmenu
```

## config/drivers/sensor/iqs550/Kconfig
```kconfig
# Copyright (c) 2024 The ZMK Contributors
# SPDX-License-Identifier: Apache-2.0

config AZOTEQ_IQS550
	bool "Azoteq IQS550 Touchpad Driver"
	default n
	select INPUT
	select I2C
	select GPIO
	select LOG
	select POINTING_DEVICE
	help
	  Enable the driver for the Azoteq IQS550 touchpad sensor.
	  This sensor provides XY coordinates and touch status via I2C.

if AZOTEQ_IQS550

config AZOTEQ_IQS550_LOG_LEVEL_ERR
	bool "Error"
	select LOG_LEVEL_ERR
	select LOG_LEVEL_SET

config AZOTEQ_IQS550_LOG_LEVEL_WRN
	bool "Warning"
	select LOG_LEVEL_WRN
	select LOG_LEVEL_SET

config AZOTEQ_IQS550_LOG_LEVEL_INF
	bool "Info"
	select LOG_LEVEL_INF
	select LOG_LEVEL_SET

config AZOTEQ_IQS550_LOG_LEVEL_DBG
	bool "Debug"
	select LOG_LEVEL_DBG
	select LOG_LEVEL_SET

config AZOTEQ_IQS550_LOG_LEVEL
	string "Log level"
	default "ERR" if AZOTEQ_IQS550_LOG_LEVEL_ERR
	default "WRN" if AZOTEQ_IQS550_LOG_LEVEL_WRN
	default "INF" if AZOTEQ_IQS550_LOG_LEVEL_INF
	default "DBG" if AZOTEQ_IQS550_LOG_LEVEL_DBG
	default "ERR"

endif # AZOTEQ_IQS550
```

## config/drivers/sensor/iqs550/Kconfig.defconfig
```kconfig
# Copyright (c) 2024 The ZMK Contributors
# SPDX-License-Identifier: Apache-2.0

config ZMK_MOUSE
	default y
	depends on IQS550

config SENSOR
	default y
	depends on IQS550

config I2C
	default y
	depends on IQS550
```

## config/dts/bindings/sensor/azoteq,iqs-manus.yaml
```yaml
# Copyright (c) 2024 Manus AI
# SPDX-License-Identifier: Apache-2.0

description: |
  Sensor driver for the Azoteq IQS5xx series trackpad IC, adapted for Manus.

compatible: "azoteq,iqs-manus"

include: ["i2c-device.yaml", "gpio-consumer.yaml"]

properties:
  irq-gpios:
    type: phandle-array
    required: true
    description: |
      The interrupt pin (RDY/DR) from the touchpad.
      The pin should be configured as active high.

  reset-gpios:
    type: phandle-array
    required: false
    description: |
      The reset pin for the touchpad.
      The pin should be configured as active low.

  flip-x:
    type: boolean
    description: Flip the X axis.

  flip-y:
    type: boolean
    description: Flip the Y axis.

  switch-xy:
    type: boolean
    description: Switch the X and Y axes.

  # Default resolutions for TPS65-201A-S (IQS550)
  # These are not typically needed as the driver reads relative data
  # x-resolution:
  #   type: int
  #   default: 3072
  #   description: Horizontal resolution of the touchpad.
  # y-resolution:
  #   type: int
  #   default: 2048
  #   description: Vertical resolution of the touchpad.
```

## config/dts/bindings/sensor/azoteq,iqs550.yaml
```yaml
# Copyright (c) 2024 The ZMK Contributors
# SPDX-License-Identifier: Apache-2.0

description: Azoteq IQS550 Touchpad

compatible: "azoteq,iqs550"

include: i2c-device.yaml

properties:
  irq-gpios:
    type: phandle-array
    required: true
    description: |
      The RDY (Ready) pin. Indicates data is available for reading.
      The pin should be configured as active high.

  reset-gpios:
    type: phandle-array
    required: false
    description: |
      The RESET pin. Used to reset the device.
      The pin should be configured as active low.
```

## config/west.yml
```yaml
manifest:
  remotes:
    - name: zmkfirmware
      url-base: https://github.com
  projects:
    - name: zmk
      revision: main
      clone-depth: 1
      url: https://github.com/Ahmed-M-Osman1/zmk-azoteq
      import: app/west.yml
  self:
    path: config
```

## modules/drivers/zmk_azoteq_manus_driver/drivers/sensor/azoteq_iqs_manus/Kconfig
```kconfig
# Copyright (c) 2024 Manus AI
# SPDX-License-Identifier: Apache-2.0

# Kconfig for Azoteq IQS-Manus Touchpad Driver

config AZOTEQ_IQS_MANUS
	bool "Azoteq IQS-Manus Touchpad Driver"
	depends on I2C
	depends on INPUT
	select INPUT_POINTING_DEVICE
	help
	  Enable the Azoteq IQS-Manus series touchpad driver.
	  This driver is adapted for ZMK and provides support for
	  IQS5xx-based touchpads, with extensive debugging capabilities.

if AZOTEQ_IQS_MANUS

config AZOTEQ_IQS_MANUS_LOG_LEVEL
	int "Log level for Azoteq IQS-Manus driver"
	default 3 # LOG_LEVEL_INF
	range 0 4
	help
	  Set the log level for the Azoteq IQS-Manus driver.
	  0 = OFF, 1 = ERR, 2 = WRN, 3 = INF, 4 = DBG.
	  For detailed debugging, set this to 4.

endif # AZOTEQ_IQS_MANUS
```
